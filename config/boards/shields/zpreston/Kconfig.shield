## config/boards/shields/zpreston/Kconfig.shield
```kconfig
config SHIELD_ZPRESTON_LEFT
	def_bool $(shields_list_contains,zpreston_left)

config SHIELD_ZPRESTON_RIGHT
	def_bool $(shields_list_contains,zpreston_right)
```
